/*******************************************************************************
errorlog:XM430-RとほかのTTLタイプが同時には動かない。TTLタイプに統一?
*******************************************************************************/

#include <DynamixelWorkbench.h>
#include "setup_para.h"
#include "dynamixelHsrlLib.h"
#include "robotControl.h"
#include "ROSSetup.h"


#define __SERIAL_WAIT_ON               //実動作試験ではコメントアウト
#define __Dynamixel_ON                 //DynamixelをOFFしたい場合コメントアウト　
#define __TimerLoop_ON                 //TimerloopをOFFしたい場合コメントアウト
//#define __Debug_ON                   //SerialモニタをOFFしたい場合コメントアウト 
//#define __Torque_OFF

DynamixelWorkbench dxl_wb;
HardwareTimer Timer(TIMER_CH1); //Periodic timerloop
DYNAMIXEL_JOINT DJ[Jnum+1];

extern int srv_flag;
extern int req_trajectry_size;
extern int req_trajectry_points_size;

extern void RosInit();
extern void joint_states_pub();
extern uint8_t setTrajePoints_S1();   //paintingTrajectoryをセットする関数
extern uint8_t setTrajePoints_S2();   //paintingTrajectoryをセットする関数
extern uint8_t setTrajePoints_S3();   //paintingTrajectoryをセットする関数
extern uint8_t setTrajePoints_S4();   //paintingTrajectoryをセットする関数
extern uint8_t setTrajePoints_S5();

Robot rb;                       //Robot 構造体
unsigned long time_passed;
unsigned long time_old;
uint32_t cTime;                //timerloopの内部処理時間
uint32_t cTime_old;
uint8_t servoOutputFlag = 0;

typedef enum { st_OfflineSinTrajectory=2,
               st_Error=99,
               st_Debug=100               
}status_t;

uint8_t modeNum = 100; //st_OfflineSinTrajectory;
uint8_t pTask_flag = 0;                  //1平面

//=========== sync_write用変数===========2022/03/01追加
uint8_t dxl_id[Jnum] = {0,};
int32_t goal_position[Jnum] = {0,};
const uint8_t handler_index = 0;
//=====================================
void calPulse2AngleSync_Read();

//-------------------SET UP------------------
void setup() 
{
  const char *log;
  bool result = false;

#ifdef __Debug_ON
  Serial.begin(115200);
  //Serial2.begin(115200); 
  #ifdef __SERIAL_WAIT_ON
   while(!Serial); // Wait for Opening Serial Monitor
  #endif 
  delay(1000);
#endif 
  
//  RC100_setup();         //Joystick setup 
//  delay(1000);

 //---パラメータ初期化
  SetupParameter();
 
  for(uint8_t i=Jnum_S; i <= Jnum_F ;i++) dxl_id[i-1]=DJ[i].id;   //sync用ID配列
 
  //***************************************ros
  RosInit();
 #ifdef __Dynamixel_ON  
 //---Dynamixelの認識
  RecognitionJoint(DJ[J1].jnum); 
  RecognitionJoint(DJ[J2].jnum); 
  RecognitionJoint(DJ[J3].jnum); 
  RecognitionJoint(DJ[J4].jnum); 
  RecognitionJoint(DJ[J5].jnum); 
  RecognitionJoint(DJ[J6].jnum); 
  RecognitionDynamixel(ID_J20);               //J2のdual駆動で、直接Dynamixel IDを設定 
 
  for(uint8_t i=Jnum_S; i <= Jnum_F ;i++){
    dxl_wb.torqueOff(DJ[i].id);
    dxl_wb.setTimeBasedProfile(DJ[i].id);
    dxl_wb.itemWrite(DJ[i].id, "Profile_Velocity",2000);  //リフトの速度制限を200*0.229 rpmに設定
    dxl_wb.itemWrite(DJ[i].id, "Profile_Acceleration",100);  
    dxl_wb.torqueOn(DJ[i].id);
  }

//---Dynamixelの初期化及びモード設定
 EPCM_Set_Init( DJ[J3].jnum, DJ[J3].ang.offset, DJ[J3].ang.init, 2000, DJ[J3].revmode);  //dyn125degを関節30degに。 162
 EPCM_Set_Init( DJ[J1].jnum, DJ[J1].ang.offset, DJ[J1].ang.init, 2000, DJ[J1].revmode);  //dyn315degを関節0degに。
 EPCM_Set_Init( DJ[J4].jnum, DJ[J4].ang.offset, DJ[J4].ang.init, 2000, DJ[J4].revmode);  //dyn180degを関節0degに。
 EPCM_Set_Init( DJ[J5].jnum, DJ[J5].ang.offset, DJ[J5].ang.init, 2000, DJ[J5].revmode);  //dyn180degを関節0degに。180
 EPCM_Set_Init( DJ[J6].jnum, DJ[J6].ang.offset, DJ[J6].ang.init, 2000, DJ[J6].revmode);  //dyn180degを関節0degに。
 EPCM_Set_Init( DJ[J2].jnum, DJ[J2].ang.offset, DJ[J2].ang.init, 2000, DJ[J2].revmode);  //dyn105degを関節150degに。245



//////////////////////////////////////////////////////////////////////
 //=======パラメータセットアップ後にsync用配列にidを入力   2022/03/01追加

 ///// sync用のhandlerに各パラメータを登録
  result = dxl_wb.addSyncWriteHandler(dxl_id[0], "Goal_Position", &log);
  if (result == false){ Serial.println(log);  Serial.println("Failed to add sync write handler"); }
  Serial.println(handler_index);
  
  result = dxl_wb.addSyncReadHandler(dxl_id[0], "Present_Position", &log);
  if (result == false){ Serial.println(log);  Serial.println("Failed to add sync read handler");  }
   Serial.println(handler_index);
 //////////////////////////////////////////////////////////////////////


  //--現在角度の表示
  for(uint8_t i=Jnum_S; i <= Jnum_F ;i++){
    calPulse2Angle(DJ[i].jnum);     //DXLパルスから現在角度取得 
  }
 
#ifdef __Debug_ON  
  Serial.println("----------------------------------------------------------------");
  Serial.print("Dxl Pulse: ");
  for(uint8_t i=Jnum_S; i <= Jnum_F ;i++){ Serial.print(DJ[i].pulse.n);    Serial.print('\t');   }
  Serial.println();  
  Serial.print("Dxl angle: ");
  for(uint8_t i=Jnum_S; i <= Jnum_F ;i++){ Serial.print(DJ[i].dxlAng.n);    Serial.print('\t');   }
  Serial.println();  
  Serial.print("Jnt angle: ");
  for(uint8_t i=Jnum_S; i <= Jnum_F ;i++){ Serial.print(DJ[i].ang.n);    Serial.print('\t');   }
  Serial.println();    
  Serial.println("----------------------------------------------------------------");
  Serial.println("Mechanical Origin Position Setup Finished ");
  delay(1000);
  Serial.println("Go to Control Orign Position ");
  delay(1000);
#endif

  //作業初期ポーズへ  (任意)
 // DJ[J1].ang.g=0;  DJ[J2].ang.g=90;   DJ[J3].ang.g=0;
 // DJ[J4].ang.g=0; DJ[J5].ang.g=-90;   DJ[J6].ang.g=0;   
  DJ[J1].ang.g=0;  DJ[J2].ang.g=140;   DJ[J3].ang.g=-40;
  DJ[J4].ang.g=0; DJ[J5].ang.g=-90;   DJ[J6].ang.g=0;
  
 // goInitJointConfig(DJ[J1].jnum,DJ[J1].ang.g,1);  //関節を目標角度まで駆動  
 // goInitJointConfig(DJ[J3].jnum,DJ[J3].ang.g,1);  //関節を目標角度まで駆動  
 // goInitJointConfig(DJ[J2].jnum,DJ[J2].ang.g,1);  //関節を目標角度まで駆動
 // goInitJointConfig(DJ[J4].jnum,DJ[J4].ang.g,1);  //関節を目標角度まで駆動
 // goInitJointConfig(DJ[J5].jnum,DJ[J5].ang.g,1);  //関節を目標角度まで駆動
 // goInitJointConfig(DJ[J6].jnum,DJ[J6].ang.g,1);  //関節を目標角度まで駆動


  for(uint8_t i=Jnum_S; i <= Jnum_F ;i++){
    dxl_wb.itemWrite(DJ[i].id, "Profile_Velocity",1000);  //リフトの速度制限を200*0.229 rpmに設定
    dxl_wb.itemWrite(DJ[i].id, "Profile_Acceleration",100);  
    dxl_wb.itemWrite(DJ[i].id, "Position_P_Gain",1000); 
    dxl_wb.itemWrite(DJ[i].id, "Position_I_Gain",10); 
  }

   goInitJointConfig(DJ[J3].jnum,DJ[J3].ang.g,1);  //関節を目標角度まで駆動 
   goInitJointConfig(DJ[J5].jnum,DJ[J5].ang.g,1);  //関節を目標角度まで駆動
   goInitJointConfig(DJ[J2].jnum,DJ[J2].ang.g,1);  //関節を目標角度まで駆動
   goInitJointConfig(DJ[J4].jnum,DJ[J4].ang.g,1);  //関節を目標角度まで駆動
   goInitJointConfig(DJ[J6].jnum,DJ[J6].ang.g,1);  //関節を目標角度まで駆動
   goInitJointConfig(DJ[J1].jnum,DJ[J1].ang.g,1);  //関節を目標角度まで駆動 

 //--現在角度の表示
 // for(uint8_t i=Jnum_S; i <= Jnum_F ;i++){
 //   calPulse2Angle(DJ[i].jnum);     //DXLパルスから現在角度取得 
 // }
 
  calPulse2AngleSync_Read(); 

#ifdef __Debug_ON   
  Serial.println("----------------------------------------------------------------");
  Serial.print("Dxl Pulse: ");
  for(uint8_t i=Jnum_S; i <= Jnum_F ;i++){ Serial.print(DJ[i].pulse.n);    Serial.print('\t');   }
  Serial.println();  
  Serial.print("Dxl angle: ");
  for(uint8_t i=Jnum_S; i <= Jnum_F ;i++){ Serial.print(DJ[i].dxlAng.n);    Serial.print('\t');   }
  Serial.println();  
  Serial.print("Jnt angle: ");
  for(uint8_t i=Jnum_S; i <= Jnum_F ;i++){ Serial.print(DJ[i].ang.n);    Serial.print('\t');   }
  Serial.println();    
  Serial.println("----------------------------------------------------------------");
#endif   
 // testJointMotion();
  
  for(uint8_t i=Jnum_S; i <= Jnum_F ;i++){  
    dxl_wb.itemWrite(DJ[i].id, "Profile_Velocity",200);  //リフトの速度制限を200*0.229 rpmに設定
    dxl_wb.itemWrite(DJ[i].id, "Profile_Acceleration",5);  
 }

#endif  
 //testMakeTrajectoryPoints();
 //testMakeTrajectoryPointsLinear();
// testMakeTrajectoryPointsLinear_v10cms();
// testMakeTrajectoryPointsLinear_v20cms();
// setTrajePoints_S1();
 delay(3000);
//rb.subst=1;                   //sub状態遷移変数
time_old = millis();
#ifdef __TimerLoop_ON
//-TimerLoop----------------
  Timer.stop();
  Timer.setPeriod(TIMER_RATE);           // in microseconds
  Timer.attachInterrupt(timerloop);
  Timer.start(); 
//-----------------------
#endif 

#ifdef __Torque_OFF
 for(uint8_t i=Jnum_S; i <= Jnum_F ;i++){  
      result = dxl_wb.torqueOff(DJ[i].id, &log); 
  }
#endif

}


/////////////   loop  ////////////////////////////////
void loop() 
{
   const char *log;  
   bool result = false;   
   static bool taskCompleted = false;
   time_passed=micros()-time_old;
   //RC100_update(); 

   // readCommand();
  //if(servoOutputFlag){
  //   calPulse2AngleSync_Read(); 
  //   setGoalPulseSync_Write();
  //   servoOutputFlag = 0;
  //}

  if(!taskCompleted){
  if(setTrajePoints_S1()) {srv_flag=1; modeNum=2; pTask_flag=0;}
  Serial.println("S1");
  while(pTask_flag==0){ Serial.println("S1"); delay(100);};
 
  Serial.println("S1 completed. S2 start");
  delay(3000);
  if(setTrajePoints_S2()) {srv_flag=1; modeNum=2; pTask_flag=0;}
  while(pTask_flag==0){Serial.println("S2"); delay(100);};

  Serial.println("S2 completed. S3 start");
  delay(3000);
  if(setTrajePoints_S3()) {srv_flag=1; modeNum=2; pTask_flag=0;}
  while(pTask_flag==0){Serial.println("S3"); delay(100);};
 
  Serial.println("S3 completed. S4 start");
  delay(3000);
  if(setTrajePoints_S4()) {srv_flag=1; modeNum=2; pTask_flag=0;}
  while(pTask_flag==0){Serial.println("S4"); delay(100);};

  Serial.println("S4 completed. S5 start");
  delay(3000);
  if(setTrajePoints_S5()) {srv_flag=1; modeNum=2; pTask_flag=0;}
  while(pTask_flag==0){Serial.println("S5"); delay(100);};

  taskCompleted=true;
  Serial.println("All plane painting completed");
  }    
  joint_states_pub();
  time_old = micros();
}

//////////////////////////TimerLoop  //////////////////
void timerloop(void) {

   const char *log;  
   bool result = false;   
  
   cTime_old = micros();

 ////角度取得 pulse to ang_n
 // for(uint8_t i=Jnum_S; i <= Jnum_F ;i++) calPulse2Angle(DJ[i].jnum);   
  calPulse2AngleSync_Read(); 
 //// タスク  
  switch(modeNum){

    case 0:                //Joystick
       //joystickTask();           
       if(moveJoint(DJ[1].jnum,50,3)) 
       if(moveJoint(DJ[1].jnum,-50,3))
       if(moveJoint(DJ[1].jnum,0,3)) modeNum=100;
        
       break;
    case st_OfflineSinTrajectory: 
      
//        if(srv_flag==1){
            for(uint8_t i=Jnum_S; i <= Jnum_F ;i++) DJ[i].trFlag=exeTrajectoryPoints(DJ[i].jnum);
            tone(BDPIN_BUZZER, (int)DJ[J2].ang.g*10, 1000);
           // if(rtimeDelay(3000)){ 
           //   if(DJ[J1].trFlag){modeNum=100; DJ[J1].trIdx=0;DJ[J1].trFlag=0;}}
  //       }

        for(uint8_t i=Jnum_S; i <= Jnum_F ;i++){
          setGoalAngle2Pulse(DJ[i].jnum);                  //目標角度をpulseにセット
          goal_position[i-1] = (int32_t)DJ[i].pulse.g;     //目標パルスをsync_write_goalpositionにセット
        }        
        
         //dynamixelへgoal_pulseをSync_write    
         setGoalPulseSync_Write();                       
                                       
        if(DJ[J1].trFlag){srv_flag=0; pTask_flag = 1; modeNum=100;}
        
         break;  
         
     case 100:
     
       break;
      
   default: break;
  }

 // for(uint8_t i=Jnum_S; i <= Jnum_F ;i++){ DJ[i].ang.g_buf = DJ[i].ang.g;}
  cTime = micros()- cTime_old;            //ms
#ifdef __Debug_ON     
  for(uint8_t i=Jnum_S; i <= Jnum_F ;i++){ Serial.print(DJ[i].ang.n);    Serial.print('\t');   }
  Serial.println(cTime);
#endif  
  servoOutputFlag = 1; 
}

//////// 目標角度をsyncWriteする   20220303追加
void setGoalPulseSync_Write(){
  //&dxl_id[]:synwriteするid配列の最初adress
  //3は、idの個数、
  //&goal_position[]:ynwriteするgoal_position配列の最初adress
  //1は、各idごとのgoal_positionデータの個数.
  
   dxl_wb.syncWrite(handler_index,&dxl_id[0],3,&goal_position[0],1);  //goal_positionをsyncWrite  
   dxl_wb.syncWrite(handler_index,&dxl_id[3],3,&goal_position[3],1);  //goal_positionをsyncWrite  
  
}

//////// 角度を計測するSync_Read 関数    20220301追加
void calPulse2AngleSync_Read(){
  //syncReadをする際、typeが異なるアクチュエータを連続で呼び出すと正常に読み取れない。
  //３つずつhandlerを呼び出すと正常に読み取れる。
   const char *log;   
   bool result = false;
   int32_t present_position[Jnum] = {0,}; 
    
   result = dxl_wb.syncRead(handler_index,&dxl_id[0],3,&log);   //J1,J2,J3をsync read
   result = dxl_wb.getSyncReadData(handler_index,&dxl_id[0],3, &present_position[0], &log);
   
   for(uint8_t i=Jnum_S; i <= Jnum_S+2 ;i++){
     DJ[i].pulse.n = present_position[i-1];
     DJ[i].dxlAng.n = DJ[i].dir_rot*(DJ[i].pulse.n*DJ[i].pul2deg);
     DJ[i].ang.n = DJ[i].dir_rot*(DJ[i].pulse.n-DJ[i].pulse.offset)*DJ[i].pul2deg*DJ[i].gearRatio*DJ[i].deg2dist;   
   }  

    result = dxl_wb.syncRead(handler_index,&dxl_id[3],3,&log);  //J3,J4,J5をsync read
    result = dxl_wb.getSyncReadData(handler_index,&dxl_id[3],3, &present_position[3], &log);
       
   for(uint8_t i=Jnum_S+3; i <= Jnum_F ;i++){
     DJ[i].pulse.n = present_position[i-1];
     DJ[i].dxlAng.n = DJ[i].dir_rot*(DJ[i].pulse.n*DJ[i].pul2deg);
     DJ[i].ang.n = DJ[i].dir_rot*(DJ[i].pulse.n-DJ[i].pulse.offset)*DJ[i].pul2deg*DJ[i].gearRatio*DJ[i].deg2dist;   
   }  
}  




////////////////////////////////////////////////////////////
void testJointMotion(){

  delay(3000);
  goInitJointConfig(DJ[J1].jnum, -45,1);  //関節を目標角度まで駆動 
  goInitJointConfig(DJ[J1].jnum, 45,1);  //関節を目標角度まで駆動 
  goInitJointConfig(DJ[J1].jnum, 0,1);  //関節を目標角度まで駆動 
  delay(500);
  goInitJointConfig(DJ[J2].jnum, 30,1);  //関節を目標角度まで駆動 
  goInitJointConfig(DJ[J2].jnum, 150,1);  //関節を目標角度まで駆動 
  delay(500);
  goInitJointConfig(DJ[J3].jnum, 10,3);  //関節を目標角度まで駆動 
  goInitJointConfig(DJ[J3].jnum, 90,3);  //関節を目標角度まで駆動 
  delay(500);
  goInitJointConfig(DJ[J4].jnum, 90,3);  //関節を目標角度まで駆動 
  goInitJointConfig(DJ[J4].jnum, 0,3);  //関節を目標角度まで駆動 
  delay(500);
  goInitJointConfig(DJ[J5].jnum, -90,5);  //関節を目標角度まで駆動 
  goInitJointConfig(DJ[J5].jnum, 0,5);  //関節を目標角度まで駆動 
  delay(500);
  goInitJointConfig(DJ[J6].jnum, 90,3);  //関節を目標角度まで駆動 
  goInitJointConfig(DJ[J6].jnum, 0,3);  //関節を目標角度まで駆動 
 }
 
void testMakeTrajectoryPoints(){

  /////////////Trajectoryの生成///////////////////////////////////
 float startTime=0.0;         //軌道スタート時間s
 float finishTime=5.0;        //軌道終了時間s
 float invTime = (TIMER_RATE/1000)*0.001;                               //インターバル時間
 uint16_t timeStampIndex =0;          //時間index
 uint16_t trajIndex=0;
 float tt;                            //時間

  for(uint8_t i=Jnum_S; i <= Jnum_F ;i++){
  
 DJ[i].trIdxMax=(uint16_t)((finishTime-startTime)/invTime);    //最大index値

 for(tt=startTime; tt<=finishTime; tt+=invTime){
//   trajTT[timeStampIndex++] = tt;  // 2*3.14*f(hz) 
   DJ[i].trajPoints[trajIndex] = 30*sin(2*3.14*0.2*tt);  // 2*3.14*f(hz) 
   trajIndex++;
 }
 trajIndex=0;
}

 for(uint8_t i=Jnum_S; i <= Jnum_F ;i++){
  for(int idx=0; idx<=DJ[i].trIdxMax; idx++){
  
  }
   delay(3000);
 }
/////////////////////////////////////////////////////////////// 
}

void testMakeTrajectoryPointsLinear(){

  float trpointsJ1[51]={
                          0,1.27,2.54,3.81,5.08,6.34,7.59,8.84,10.08,11.31,12.53,13.74,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48.02
                        };
  float trpointsJ2[51]={
                         90,89.98,89.92,89.82,89.69,89.51,89.3,89.05,88.76,88.43,88.06,87.66,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44
                        };
  float trpointsJ3[51]={
                          0,0.02,0.08,0.18,0.31,0.49,0.71,0.96,1.25,1.59,1.96,2.37,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58.76
                        };
  float trpointsJ4[51]={
                          0,0,0,0,0,0,0,0,-0,0,0,0,0,0,0,0,0,0,0,0,0,0,-0,0,-0,0,0,0,0,0,0,0,0,0,0,0,-0,-0,-0,0,0,0,0,0,0,0,0,0,0,0,-0
                        };
  float trpointsJ5[51]={
                          -90,-90,-90,-90,-90,-90,-90,-90.01,-90.01,-90.02,-90.02,-90.04,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-102.76
                        };

  float trpointsJ6[51]={
                           0,1.27,2.54,3.81,5.08,6.34,7.59,8.84,10.08,11.31,12.53,13.74,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48.02
                        };
                        
  for(uint16_t i=0;i<51;i++){
        DJ[J1].trajPoints[i]=trpointsJ1[i]; 
        DJ[J2].trajPoints[i]=trpointsJ2[i]; 
        DJ[J3].trajPoints[i]=trpointsJ3[i]; 
        DJ[J4].trajPoints[i]=trpointsJ4[i]; 
        DJ[J5].trajPoints[i]=trpointsJ5[i]; 
        DJ[J6].trajPoints[i]=trpointsJ6[i]; 
  }

  for(uint8_t i=Jnum_S; i <= Jnum_F ;i++) DJ[i].trIdxMax =51;
}


void testMakeTrajectoryPointsLinear_v10cms(){

 uint16_t tSize = 558;   //0.1m/s 558   0.2m/s 280

  float trpointsJ1[tSize]={
                          0,0.41,0.83,1.24,1.66,2.07,2.48,2.9,3.31,3.72,4.14,4.55,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0
                        };
  float trpointsJ2[tSize]={
                         90,90,89.99,89.98,89.97,89.95,89.93,89.9,89.87,89.83,89.79,89.75,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90
                        };
  float trpointsJ3[tSize]={
                          0,0,0.01,0.01,0.02,0.04,0.06,0.08,0.1,0.13,0.16,0.19,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0
                        };
  float trpointsJ4[tSize]={
                          0,0.27,0.53,0.8,1.07,1.33,1.6,1.87,2.13,2.4,2.66,2.93,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0
                        };
  float trpointsJ5[tSize]={
                         -90,-90,-89.99,-89.98,-89.96,-89.94,-89.91,-89.88,-89.84,-89.8,-89.76,-89.71,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-90
                        };

  float trpointsJ6[tSize]={
                           0,0.41,0.83,1.24,1.66,2.07,2.48,2.89,3.31,3.72,4.13,4.54,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0
                        };

  int spNum = 2;                                  //補間データ数      (uint)(waypoints周期時間(ms)/(TIMER_RATE/1000))
  float new_trpointsJ1[(tSize-1)*spNum+1]={0,};   //新しい軌道配列
  float new_trpointsJ2[(tSize-1)*spNum+1]={0,};   //新しい軌道配列
  float new_trpointsJ3[(tSize-1)*spNum+1]={0,};   //新しい軌道配列
  float new_trpointsJ4[(tSize-1)*spNum+1]={0,};   //新しい軌道配列
  float new_trpointsJ5[(tSize-1)*spNum+1]={0,};   //新しい軌道配列
  float new_trpointsJ6[(tSize-1)*spNum+1]={0,};   //新しい軌道配列
  
  float trajStep[Jnum]={0,};                               //補間軌道のステップ値

  for(uint16_t i=0; i< tSize-1; i++){ 
    trajStep[0] = (trpointsJ1[i+1] - trpointsJ1[i])/(float)spNum; 
    trajStep[1] = (trpointsJ2[i+1] - trpointsJ2[i])/(float)spNum; 
    trajStep[2] = (trpointsJ3[i+1] - trpointsJ3[i])/(float)spNum; 
    trajStep[3] = (trpointsJ4[i+1] - trpointsJ4[i])/(float)spNum; 
    trajStep[4] = (trpointsJ5[i+1] - trpointsJ5[i])/(float)spNum; 
    trajStep[5] = (trpointsJ6[i+1] - trpointsJ6[i])/(float)spNum; 
                        
    for(uint16_t j=0; j <= spNum; j++){
       new_trpointsJ1[i*spNum+j]=trpointsJ1[i]+trajStep[0]*j;
       new_trpointsJ2[i*spNum+j]=trpointsJ2[i]+trajStep[1]*j;
       new_trpointsJ3[i*spNum+j]=trpointsJ3[i]+trajStep[2]*j;
       new_trpointsJ4[i*spNum+j]=trpointsJ4[i]+trajStep[3]*j;
       new_trpointsJ5[i*spNum+j]=trpointsJ5[i]+trajStep[4]*j;
       new_trpointsJ6[i*spNum+j]=trpointsJ6[i]+trajStep[5]*j;               
    }
  }

  for(uint16_t i=0; i< (tSize-1)*spNum+1; i++){
        DJ[J1].trajPoints[i]=new_trpointsJ1[i]; 
        DJ[J2].trajPoints[i]=new_trpointsJ2[i]; 
        DJ[J3].trajPoints[i]=new_trpointsJ3[i]; 
        DJ[J4].trajPoints[i]=new_trpointsJ4[i]; 
        DJ[J5].trajPoints[i]=new_trpointsJ5[i]; 
        DJ[J6].trajPoints[i]=new_trpointsJ6[i]; 
//        Serial.print(DJ[1].trajPoints[i]);  Serial.print('\t');
//        Serial.print(DJ[2].trajPoints[i]);  Serial.print('\t');
//        Serial.print(DJ[3].trajPoints[i]); Serial.print('\t');
//        Serial.print(DJ[4].trajPoints[i]); Serial.print('\t');
//        Serial.print(DJ[5].trajPoints[i]); Serial.print('\t');
//        Serial.println(DJ[6].trajPoints[i]); 
  }

  for(uint8_t i=Jnum_S; i <= Jnum_F ;i++) DJ[i].trIdxMax =(tSize-1)*spNum+1;
}

void testMakeTrajectoryPointsLinear_v20cms(){

  uint16_t tSize = 280;

  float trpointsJ1[tSize]={
                          0,0.84,1.68,2.52,3.36,4.19,5.03,5.86,6.69,7.52,8.35,9.17,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0
                        };
  float trpointsJ2[tSize]={
                         90,89.99,89.97,89.92,89.86,89.79,89.69,89.58,89.46,89.31,89.15,88.97,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90
                        };
  float trpointsJ3[tSize]={
                          0,0.01,0.03,0.06,0.1,0.16,0.23,0.31,0.41,0.52,0.64,0.78,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0
                        };
  float trpointsJ4[tSize]={
                          0,0.54,1.08,1.62,2.16,2.7,3.23,3.77,4.3,4.83,5.35,5.87,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0
                        };
  float trpointsJ5[tSize]={
                          -90,-89.99,-89.96,-89.91,-89.84,-89.75,-89.64,-89.51,-89.36,-89.2,-89.01,-88.81,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-90
                        };

  float trpointsJ6[tSize]={
                           0,0.84,1.68,2.52,3.35,4.18,5.01,5.84,6.66,7.48,8.29,9.09,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0
                        };
                        
  for(uint16_t i=0;i<tSize;i++){
        DJ[J1].trajPoints[i]=trpointsJ1[i]; 
        DJ[J2].trajPoints[i]=trpointsJ2[i]; 
        DJ[J3].trajPoints[i]=trpointsJ3[i]; 
        DJ[J4].trajPoints[i]=trpointsJ4[i]; 
        DJ[J5].trajPoints[i]=trpointsJ5[i]; 
        DJ[J6].trajPoints[i]=trpointsJ6[i]; 
/*        Serial.print(DJ[1].trajPoints[i]);  Serial.print('\t');
        Serial.print(DJ[2].trajPoints[i]);  Serial.print('\t');
        Serial.print(DJ[3].trajPoints[i]); Serial.print('\t');
        Serial.print(DJ[4].trajPoints[i]); Serial.print('\t');
        Serial.print(DJ[5].trajPoints[i]); Serial.print('\t');
        Serial.println(DJ[6].trajPoints[i]); */
  }

  for(uint8_t i=Jnum_S; i <= Jnum_F ;i++) DJ[i].trIdxMax =tSize;
}


  
